## drivers/gpio/Kconfig.ds2413
```kconfig
# Copyright (c) 2022 Caspar Friedrich <c.s.w.friedrich@gmail.com>
# SPDX-License-Identifier: Apache-2.0

config GPIO_DS2413
	bool "DS2413 1-Wire IO-Controller"
	depends on W1
	select GPIO_DRV_CMD
```

## drivers/w1/Kconfig.ds2482-800
```kconfig
config W1_DS2482_800
	bool "DS2482-800 8-Channel 1-Wire Master"
	default y if $(dt_compat_enabled,$(maxim,ds2482-800))
	depends on I2C
```

## drivers/w1/Kconfig.ds2484
```kconfig
config W1_DS2484
	bool "DS2484 Single-Channel 1-Wire Master"
	default y if $(dt_compat_enabled,$(maxim,ds2484))
	depends on I2C
```

## dts/bindings/gpio/maxim,ds2413.yaml
```yaml
# Copyright (c) 2022 Caspar Friedrich <c.s.w.friedrich@gmail.com>
# SPDX-License-Identifier: Apache-2.0

description: DS2413 1-Wire Dual Channel Addressable Switch

compatible: "maxim,ds2413"

include: [w1-device.yaml, gpio-controller.yaml]

properties:
    "#gpio-cells":
      const: 2

    ngpios:
      const: 2

gpio-cells:
  - pin
  - flags
```

## dts/bindings/w1/maxim,ds2482-800.yaml
```yaml
description: DS2482-800 8-Channel 1-Wire Master

compatible: "maxim,ds2482-800"

include: [i2c-device.yaml, w1-controller.yaml]

properties:
  active-pullup:
    type: boolean
    description: |
      Controls whether an active pullup or a passive pullup is used to drive a
      1-Wire line from low to high.
```
